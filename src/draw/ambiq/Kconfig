## src/draw/ambiq/Kconfig
```kconfig
config LV_USE_DRAW_AMBIQ
	bool "Ambiq GPU renderer"
	default n
	select LV_USE_MATRIX
	select LV_USE_AMBIQ_VG
	help
		Use Ambiq's GPU on Apollo4x or Apollo5x chips.

if LV_USE_DRAW_AMBIQ

config LV_USE_AMBIQ_VG
	bool "Ambiq vector graphics"
	default n
	select LV_DRAW_HAS_VECTOR_SUPPORT

config LV_AMBIQ_CPU_GPU_ASYNC
	bool "Make CPU and GPU work in asynchronous mode"
	default n

config LV_AMBIQ_GPU_POWER_SAVE
	bool "Enable GPU power management, power off GPU at frame end."
	default n

config LV_USE_AMBIQ_TTF
	bool "Enable Ambiq TTF solution, it will offer better performance and less memory occupation."
	default n

config LV_AMBIQ_COMMAND_LIST_SECTOR
	int "Command list sectors number"
	default 100
	help
		The command list is divided into `LV_AMBIQ_COMMAND_LIST_SECTOR` sectors,
		where each sector has a fixed length of `LV_AMBIQ_COMMAND_LIST_SECTOR_SIZE`.

config LV_AMBIQ_COMMAND_LIST_SECTOR_SIZE
	int "Command list sector size in bytes"
	default 1024
	help
		The command list is divided into `LV_AMBIQ_COMMAND_LIST_SECTOR` sectors,
		where each sector has a fixed length of `LV_AMBIQ_COMMAND_LIST_SECTOR_SIZE`.

endif
```
